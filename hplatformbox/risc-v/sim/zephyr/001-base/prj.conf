## CMakeLists.txt
```
cmake_minimum_required(VERSION 3.20.0)

find_package(Zephyr REQUIRED HINTS $ENV{ZEPHYR_BASE})
project(base)

include_directories(${CMAKE_CURRENT_LIST_DIR})
add_compile_definitions(-DHBOX_CONFIG_HEADER=hbox_config.h )

target_sources(app PRIVATE src/main.cpp)

#设定HRC文件系统目录为fs
set(HRC_FS_ROOT_DIR ${CMAKE_CURRENT_LIST_DIR}/fs/)
add_subdirectory(${CMAKE_CURRENT_LIST_DIR}/../../../../../hbox HBox EXCLUDE_FROM_ALL)
add_subdirectory(${CMAKE_CURRENT_LIST_DIR}/../../../../../hrc HRC EXCLUDE_FROM_ALL)
#启用HBox、HRC
target_link_libraries(app PUBLIC HBox RC)
target_link_libraries(HBox app)
target_link_libraries(h3rdparty_common app)
target_link_libraries(RC app)
target_compile_options(HBox PRIVATE -Wno-restrict )


#使用zephyr的链接脚本处理功能
zephyr_linker_sources(SECTIONS "${CMAKE_CURRENT_LIST_DIR}/../hbox.ld")

#安装路径
if(DEFINED HPLATFORMBOX_RISC_V_INSTALL_DIR)
    file(GLOB INSTALL_FILES "${CMAKE_CURRENT_LIST_DIR}/files/*")
    install(FILES ${CMAKE_CURRENT_BINARY_DIR}/zephyr/zephyr.elf
        ${CMAKE_CURRENT_BINARY_DIR}/zephyr/zephyr.dts
        ${CMAKE_CURRENT_BINARY_DIR}/zephyr/zephyr.map
        ${INSTALL_FILES}
        DESTINATION ${HPLATFORMBOX_RISC_V_INSTALL_DIR}/)
endif()
```

## prj.conf
```kconfig
CONFIG_CPP=y
CONFIG_REQUIRES_FULL_LIBCPP=y
CONFIG_SHELL=y
```

## src/main.cpp
```c
#include "hbox.h"
#include "hrc.h"
#include "zephyr/autoconf.h"
#include "zephyr/kernel.h"

int main(void)
{
    hcpprt_init();
    while(true)
    {
        hcpprt_loop();
        {
            k_timeout_t timeout={1};
            k_sleep(timeout);
        }
    }
	return 0;
}

/*
 * 主初始化
 */
void  main_init(const hruntime_function_t *func)
{
    {
        const char *banner="";
        if(RCGetHandle("banner")!=NULL)
        {
            banner=(const char *)RCGetHandle("banner");
        }
        printf("\r\nhbox init!\r\n%s",banner);
    }
}
HRUNTIME_INIT_EXPORT(main,255,main_init,NULL);
HRUNTIME_SYMBOL_EXPORT(main_init);

/*
 * 主循环
 */
void  main_loop(const hruntime_function_t *func)
{

}
HRUNTIME_LOOP_EXPORT(main,255,main_loop,NULL);
HRUNTIME_SYMBOL_EXPORT(main_loop);
```
